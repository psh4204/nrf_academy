## blinky/build_1/blinky/Kconfig/boards/Kconfig.defconfig
```kconfig
# Load Zephyr board defconfig descriptions.
osource "C:/ncs/v3.0.2/zephyr/boards/nordic/nrf7002dk/Kconfig.defconfig"
```

## ncs-fund/l2/l2_e1/build/Kconfig/Kconfig.shield
```kconfig
osource "D:/__WORKSPACE__/_nrf_/blinky/boards/shields/*/Kconfig.shield"
osource "C:/ncs/v3.0.2/nrf/boards/shields/*/Kconfig.shield"
```
